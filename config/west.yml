## config/west.yml
```yaml
manifest:
  remotes:
    - name: zmkfirmware
      url-base: https://github.com/zmkfirmware
    - name: refil
      url-base: https://github.com/refil
    - name: mine
      url-base: https://github.com/pijanowskim
    - name: urob
      url-base: https://github.com/urob
  projects:
    - name: zmk
      remote: mine
      revision: adv360-mine
      import: app/west.yml
  self:
    path: config
```
